## boards/ubx_evk_iris_w1.conf
```kconfig
CONFIG_WIFI_NXP=y
CONFIG_NXP_RW610=y

# stack size
CONFIG_HEAP_MEM_POOL_SIZE=64000
```

## modules/n6_communication/Kconfig
```kconfig
config N6_COMMUNICATION
    bool "N6 Communication Module"
    default n
    help
        Enable communication to the N6 module.

config N6_COMMUNICATION_THREAD_STACK_SIZE
    int "N6 Communication Thread Stack Size"
    default 2048
    help
        Sets the stack size (in bytes) for the N6 communication thread.
```

## modules/udp_socket/Kconfig
```kconfig
config UDP_SOCKET
    bool "UDP socket demo client for WiFi-enabled chips"
    default n
    help
        Provides run_UDP_socket_example() to connect via WiFi and exchange
        messages with a UDP echo server.

config UDP_SOCKET_THREAD_STACK_SIZE
    int "Stack size for the UDP socket demo thread"
    default 2048
    help
        This option sets the stack size for the thread running the UDP socket demo.
```

## modules/wifi_utilities/Kconfig
```kconfig
# Create a new option in menuconfig
config WIFI_UTILITIES
    bool "WiFi utilities WiFi-enabled chips, like connecting, IP address retrieval, etc."
    default n   # Set the library to be disabled by default
    help
        Adds say_hello() function to print a basic message to the console.
```
